## conf/distro/umobo-distro.conf
```bitbake
include conf/distro/poky.conf

DISTRO_VERSION = "umobo-0.1"

DISTRO_FEATURES_remove = " x11 wayland"
```

## conf/layer.conf
```bitbake
# We have a conf and classes directory, add to BBPATH
BBPATH .= ":${LAYERDIR}"

# We have recipes-* directories, add to BBFILES
BBFILES += "${LAYERDIR}/recipes-*/*/*.bb \
	${LAYERDIR}/recipes-*/*/*.bbappend"

BBFILE_COLLECTIONS += "umobo"
BBFILE_PATTERN_umobo = "^${LAYERDIR}/"
BBFILE_PRIORITY_umobo = "6"
```

## conf/machine/imx6dl-umobo.conf
```bitbake
#@TYPE: Machine
#@NAME: UMoBo
#@SOC: i.MX6S
#@DESCRIPTION: Machine configuration for i.MX6S U-MoBo.
#@MAINTAINER: Morix Dev <morix.dev@gmail.com>

include conf/machine/include/imx-base.inc
include conf/machine/include/tune-cortexa9.inc

MACHINEOVERRIDES =. "mx6:mx6dl:"

UBOOT_MACHINE = "apollo_defconfig"

PREFERRED_PROVIDER_virtual/kernel ?= "linux-fslc-imx"
KERNEL_DEVICETREE = "imx6dl-riotboard.dtb"

SERIAL_CONSOLE = "115200 ttymxc3"

MACHINE_ESSENTIAL_EXTRA_RDEPENDS += " \
    kernel-image \
    kernel-devicetree \
    u-boot-fslc \
"

WKS_FILES = "imx-uboot.wks"
```

## recipes-bsp/u-boot/u-boot-fslc/board/aesys/apollo/Kconfig
```kconfig
if TARGET_AESYSAPOLLO

config SYS_BOARD
	default "apollo"

config SYS_VENDOR
	default "aesys"

config SYS_CONFIG_NAME
	default "aesysapollo"

endif
```
